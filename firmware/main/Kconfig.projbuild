## firmware/main/Kconfig.projbuild
```kconfig
menu "Hardware Target Configuration"

    choice TARGET_HARDWARE
        prompt "Select Hardware Target"
        default TARGET_DUAL_THROTTLE
        help
            Select the hardware target for this build.
            Different targets have different screen sizes and throttle logic.

        config TARGET_DUAL_THROTTLE
            bool "dual_throttle (172x320 Screen)"
            help
                Build for dual_throttle hardware with 172x320 pixel display.

        config TARGET_LITE
            bool "lite (240x320 Screen)"
            help
                Build for lite hardware with 240x320 pixel display.
    endchoice

    config LCD_HOR_RES
        int "LCD Horizontal Resolution"
        default 172 if TARGET_DUAL_THROTTLE
        default 240 if TARGET_LITE
        help
            Horizontal resolution of the LCD display in pixels.

    config LCD_VER_RES
        int "LCD Vertical Resolution"
        default 320
        help
            Vertical resolution of the LCD display in pixels.

    config LCD_OFFSET_X
        int "LCD X Offset"
        default 34 if TARGET_DUAL_THROTTLE
        default 0 if TARGET_LITE
        help
            X offset for LCD display (panel offset).

    config LCD_OFFSET_Y
        int "LCD Y Offset"
        default 0
        help
            Y offset for LCD display (panel offset).

endmenu
```

## firmware/remote firmware/ble_spp_client/sdkconfig.defaults
```kconfig
CONFIG_ESP_MAIN_TASK_STACK_SIZE=8192
CONFIG_SPIRAM_SUPPORT=y
CONFIG_SPIRAM_USE=y
CONFIG_SPIRAM_SPEED_80M=y
CONFIG_SPIRAM=y
CONFIG_SPIRAM_BOOT_INIT=y
CONFIG_SPIRAM_USE_MALLOC=y
CONFIG_SPIRAM_TYPE_AUTO=y
CONFIG_SPIRAM_SIZE=-1
CONFIG_SPIRAM_ALLOW_STACK_EXTERNAL_MEMORY=y
CONFIG_SPIRAM_ALLOW_BSS_SEG_EXTERNAL_MEMORY=y
CONFIG_ESP_SYSTEM_MEMPROT_FEATURE=y
CONFIG_SPIRAM_MODE_OCT=y
CONFIG_SPIRAM_MEMTEST=y
CONFIG_SPIRAM_MALLOC_ALWAYSINTERNAL=16384
CONFIG_SPIRAM_TRY_ALLOCATE_WIFI_LWIP=y
CONFIG_SPIRAM_MALLOC_RESERVE_INTERNAL=32768
CONFIG_SPIRAM_CACHE_WORKAROUND=y
CONFIG_SPIRAM_BANKSWITCH_ENABLE=y
CONFIG_ESP_SYSTEM_ALLOW_RTC_FAST_MEM_AS_HEAP=y
CONFIG_SPIRAM_SPEED_40M=y
CONFIG_MEMMAP_SMP=y
CONFIG_MIPI_DISPLAY_SPI_HOST=SPI2_HOST
CONFIG_ESP_TASK_WDT_TIMEOUT_S=10
CONFIG_FREERTOS_HZ=1000
CONFIG_LV_COLOR_16_SWAP=n
CONFIG_LV_MEM_SIZE_KILOBYTES=128
CONFIG_LV_DISP_DEF_REFR_PERIOD=30
```

## firmware/remote_firmware/ble_spp_client/sdkconfig.defaults.dual_throttle
```kconfig
CONFIG_TARGET_DUAL_THROTTLE=y
# CONFIG_TARGET_LITE is not set
CONFIG_LCD_HOR_RES=172
CONFIG_LCD_VER_RES=320
CONFIG_LCD_OFFSET_X=34
CONFIG_LCD_OFFSET_Y=0
```

## firmware/sdkconfig.defaults.dual_throttle
```kconfig
# CONFIG_TARGET_LITE is not set
CONFIG_TARGET_DUAL_THROTTLE=y
CONFIG_LCD_HOR_RES=172
CONFIG_LCD_VER_RES=320
CONFIG_LCD_OFFSET_X=34
CONFIG_LCD_OFFSET_Y=0

# Console (USB Serial JTAG, not UART)
CONFIG_ESP_CONSOLE_USB_SERIAL_JTAG=y

# Partition Table
CONFIG_PARTITION_TABLE_CUSTOM=y
CONFIG_PARTITION_TABLE_CUSTOM_FILENAME="partitions.csv"

# Flash
CONFIG_ESPTOOLPY_FLASHSIZE_4MB=y
CONFIG_ESPTOOLPY_FLASHSIZE="4MB"

# SPIRAM
CONFIG_SPIRAM=y
CONFIG_SPIRAM_MODE_QUAD=y
CONFIG_SPIRAM_TYPE_AUTO=y
CONFIG_SPIRAM_SPEED_40M=y
CONFIG_SPIRAM_USE_MALLOC=y
CONFIG_SPIRAM_MALLOC_ALWAYSINTERNAL=16384
CONFIG_SPIRAM_MALLOC_RESERVE_INTERNAL=32768

# LVGL
CONFIG_LV_CONF_SKIP=y
CONFIG_LV_COLOR_16_SWAP=y

# Bluetooth Configuration
CONFIG_BT_ENABLED=y
CONFIG_BT_BLUEDROID_ENABLED=y
CONFIG_BT_BLE_ENABLED=y
CONFIG_BT_GATTC_ENABLE=y
CONFIG_BT_BLE_SMP_ENABLE=y
CONFIG_BT_BLE_42_FEATURES_SUPPORTED=y
```

## firmware/sdkconfig.defaults.lite
```kconfig
# CONFIG_TARGET_DUAL_THROTTLE is not set
CONFIG_TARGET_LITE=y
CONFIG_LCD_HOR_RES=240
CONFIG_LCD_VER_RES=320
CONFIG_LCD_OFFSET_X=0
CONFIG_LCD_OFFSET_Y=0
```
